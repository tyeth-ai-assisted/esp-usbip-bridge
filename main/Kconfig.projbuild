## main/Kconfig.projbuild
```kconfig
menu "USB/IP Bridge Configuration"

choice USBIP_BOARD
    prompt "Target board"
    default USBIP_BOARD_ESPRESSIF_ESP32P4_FUNCTION_EV if IDF_TARGET_ESP32P4
    default USBIP_BOARD_ESPRESSIF_ESP32S3_USB_OTG if IDF_TARGET_ESP32S3
    default USBIP_BOARD_ESPRESSIF_ESP32S31_FUNCTION_COREBOARD_1 if IDF_TARGET_ESP32S31
    help
        Select the target hardware board.  This selects pin mappings,
        transport defaults, and board-specific GPIO configurations.
        Board names follow CircuitPython conventions.

        Each board option auto-selects the corresponding pin table in
        the esp-harness subsystem.

    config USBIP_BOARD_NONE
        bool "none"

    config USBIP_BOARD_ESPRESSIF_ESP32P4_FUNCTION_EV
        bool "espressif_esp32p4_function_ev"
        depends on IDF_TARGET_ESP32P4

    config USBIP_BOARD_ESPRESSIF_ESP32P4X_FUNCTION_EV
        bool "espressif_esp32p4x_function_ev"
        depends on IDF_TARGET_ESP32P4

    config USBIP_BOARD_M5STACK_POE_P4
        bool "m5stack_poe_p4"
        depends on IDF_TARGET_ESP32P4

    config USBIP_BOARD_P4HIL_BOARD
        bool "p4hil_board"
        depends on IDF_TARGET_ESP32P4

    config USBIP_BOARD_ESPRESSIF_ESP32S3_USB_OTG
        bool "espressif_esp32s3_usb_otg"
        depends on IDF_TARGET_ESP32S3

    config USBIP_BOARD_ESPRESSIF_ESP32S31_FUNCTION_COREBOARD_1
        bool "espressif_esp32s31_function_coreboard_1"
        depends on IDF_TARGET_ESP32S31
endchoice

choice USBIP_TRANSPORT
    prompt "Network transport"
    default USBIP_TRANSPORT_ETHERNET if IDF_TARGET_ESP32P4 || IDF_TARGET_ESP32S31
    default USBIP_TRANSPORT_WIFI if IDF_TARGET_ESP32S3
    default USBIP_TRANSPORT_ETHERNET

    config USBIP_TRANSPORT_ETHERNET
        bool "Ethernet"
        depends on IDF_TARGET_ESP32P4 || IDF_TARGET_ESP32S31
    config USBIP_TRANSPORT_WIFI
        bool "Wi-Fi STA"
        depends on IDF_TARGET_ESP32S3
endchoice

if USBIP_TRANSPORT_ETHERNET

choice USBIP_ETH_INTERFACE
    prompt "Ethernet MAC-PHY interface"
    default USBIP_ETH_INTERFACE_RGMII if IDF_TARGET_ESP32S31
    default USBIP_ETH_INTERFACE_RMII
    help
        RMII is the 10/100 interface used by the ESP32-P4 boards.  RGMII is
        the 10/100/1000 interface used by the ESP32-S31, whose EMAC is
        gigabit-capable.

    config USBIP_ETH_INTERFACE_RMII
        bool "RMII (10/100)"
    config USBIP_ETH_INTERFACE_RGMII
        bool "RGMII (10/100/1000)"
        depends on IDF_TARGET_ESP32S31
endchoice

config USBIP_ETH_MDC_GPIO
    int "Ethernet MDC GPIO"
    default 5 if IDF_TARGET_ESP32S31
    default 31

config USBIP_ETH_MDIO_GPIO
    int "Ethernet MDIO GPIO"
    default 6 if IDF_TARGET_ESP32S31
    default 52

config USBIP_ETH_PHY_ADDR
    int "Ethernet PHY address (-1 to auto-detect)"
    range -1 31
    default 1

config USBIP_ETH_PHY_RST_GPIO
    int "Ethernet PHY reset GPIO (-1 to disable)"
    default 7 if IDF_TARGET_ESP32S31
    default 51

if USBIP_ETH_INTERFACE_RMII

config USBIP_ETH_RMII_CLK_MODE
    int "RMII clock mode (0=EXT_IN, 1=EXT_OUT)"
    range 0 1
    default 0
    help
        0 = EMAC_CLK_EXT_IN: External 50 MHz oscillator on RMII clock GPIO.
        1 = EMAC_CLK_OUT:  P4 generates 50 MHz from internal PLL, outputs
            on clock GPIO, and routes it back to an input GPIO externally.

config USBIP_ETH_RMII_CLK_GPIO
    int "RMII clock GPIO"
    default 50

config USBIP_ETH_RMII_TX_EN_GPIO
    int "RMII TX_EN GPIO"
    default 49

config USBIP_ETH_RMII_TXD0_GPIO
    int "RMII TXD0 GPIO"
    default 34

config USBIP_ETH_RMII_TXD1_GPIO
    int "RMII TXD1 GPIO"
    default 35

config USBIP_ETH_RMII_CRS_DV_GPIO
    int "RMII CRS_DV GPIO"
    default 28

config USBIP_ETH_RMII_RXD0_GPIO
    int "RMII RXD0 GPIO"
    default 29

config USBIP_ETH_RMII_RXD1_GPIO
    int "RMII RXD1 GPIO"
    default 30

endif # USBIP_ETH_INTERFACE_RMII

if USBIP_ETH_INTERFACE_RGMII

# Defaults match ETH_ESP32_EMAC_DEFAULT_CONFIG() for the ESP32-S31.

config USBIP_ETH_RGMII_TX_CLK_GPIO
    int "RGMII TX_CLK (TXC) GPIO"
    default 13

config USBIP_ETH_RGMII_RX_CLK_GPIO
    int "RGMII RX_CLK (RXC) GPIO"
    default 14

config USBIP_ETH_RGMII_PHY_REF_CLK_GPIO
    int "PHY reference clock output GPIO (-1 if the PHY has its own crystal)"
    default -1

config USBIP_ETH_RGMII_TX_CTL_GPIO
    int "RGMII TX_CTL GPIO"
    default 12

config USBIP_ETH_RGMII_TXD0_GPIO
    int "RGMII TXD0 GPIO"
    default 8

config USBIP_ETH_RGMII_TXD1_GPIO
    int "RGMII TXD1 GPIO"
    default 9

config USBIP_ETH_RGMII_TXD2_GPIO
    int "RGMII TXD2 GPIO"
    default 10

config USBIP_ETH_RGMII_TXD3_GPIO
    int "RGMII TXD3 GPIO"
    default 11

config USBIP_ETH_RGMII_RX_CTL_GPIO
    int "RGMII RX_CTL GPIO"
    default 15

config USBIP_ETH_RGMII_RXD0_GPIO
    int "RGMII RXD0 GPIO"
    default 19

config USBIP_ETH_RGMII_RXD1_GPIO
    int "RGMII RXD1 GPIO"
    default 18

config USBIP_ETH_RGMII_RXD2_GPIO
    int "RGMII RXD2 GPIO"
    default 17

config USBIP_ETH_RGMII_RXD3_GPIO
    int "RGMII RXD3 GPIO"
    default 16

config USBIP_ETH_PHY_YT8531_INIT
    bool "Apply Motorcomm YT8531 RGMII PHY init"
    default y if USBIP_BOARD_ESPRESSIF_ESP32S31_FUNCTION_COREBOARD_1
    help
        The generic 802.3 PHY driver leaves a YT8531 with auto-negotiation
        disabled after reset and without RGMII clock delays.  This re-enables
        auto-negotiation and sets ~2 ns Rx/Tx delays through the PHY's
        extended registers, as ESP-IDF's examples/ethernet/basic does.

endif # USBIP_ETH_INTERFACE_RGMII

endif

if USBIP_TRANSPORT_WIFI

config USBIP_WIFI_SSID
    string "Wi-Fi SSID"
    default ""

config USBIP_WIFI_PASSWORD
    string "Wi-Fi password"
    default ""

config USBIP_WIFI_MAX_RETRY
    int "Wi-Fi max retries"
    range 1 50
    default 10

config USBIP_WIFI_AUTHMODE
    int "Minimum AP auth mode (0=OPEN, 1=WPA, 2=WPA2, 3=WPA2/WPA3)"
    range 0 3
    default 3

config USBIP_WIFI_DISABLE_MODEM_SLEEP
    bool "Disable Wi-Fi modem sleep (WIFI_PS_NONE)"
    default y
    help
        Keeps Wi-Fi radio fully active after association. This increases power
        usage but improves latency and avoids Wi-Fi power-save side effects
        during USB host bridging.

endif

if USBIP_BOARD_P4HIL_BOARD

config USBIP_P4HIL_USB_POWER_ENABLE
    bool "Enable P4HIL USB host power via IO expander"
    default y
    help
        Set an IO expander pin high to enable VBUS power on the P4HIL board.
        USB_POWER_ON is now on an IO expander (not a direct GPIO).

config USBIP_P4HIL_USB_POWER_EXPANDER_IDX
    int "P4HIL USB power IO expander index"
    default 1
    range 0 2
    depends on USBIP_P4HIL_USB_POWER_ENABLE
    help
        Which IO expander (0, 1, or 2) the USB_POWER_ON signal is connected to.
        On the P4HIL board USB_POWER_ON is wired to expander 1, pin 15 (E1_15).

config USBIP_P4HIL_USB_POWER_EXPANDER_PIN
    int "P4HIL USB power IO expander pin"
    default 15
    range 0 15
    depends on USBIP_P4HIL_USB_POWER_ENABLE
    help
        Pin number on the IO expander for USB_POWER_ON.  E0_0..E0_5 are the
        external connector — do not use them for USB power.

endif

if IDF_TARGET_ESP32S3

config USBIP_S3_USB_OTG_DEVKIT_POWER
    bool "Enable ESP32-S3-USB-OTG board power GPIO setup"
    default y
    help
        Configure the onboard power routing GPIOs used by the ESP32-S3-USB-OTG
        board to provide VBUS in host mode.

config USBIP_S3_USB_BOOST_EN_GPIO
    int "S3 USB OTG BOOST_EN GPIO"
    default 13
    depends on USBIP_S3_USB_OTG_DEVKIT_POWER

config USBIP_S3_USB_DEV_VBUS_EN_GPIO
    int "S3 USB OTG DEV_VBUS_EN GPIO"
    default 12
    depends on USBIP_S3_USB_OTG_DEVKIT_POWER

config USBIP_S3_USB_LIMIT_EN_GPIO
    int "S3 USB OTG LIMIT_EN GPIO"
    default 17
    depends on USBIP_S3_USB_OTG_DEVKIT_POWER

config USBIP_S3_USB_SEL_GPIO
    int "S3 USB OTG USB_SEL GPIO"
    default 18
    depends on USBIP_S3_USB_OTG_DEVKIT_POWER

endif

config USBIP_SERVER_TASK_STACK
    int "USB/IP server task stack (bytes)"
    default 8192

config USBIP_SERVER_TASK_PRIORITY
    int "USB/IP server task priority"
    default 8

config USBIP_MAX_TRANSFER
    int "Maximum transfer payload size"
    range 64 16384
    default 4096
    help
        Largest single transfer handed to the USB host stack (its DMA
        buffer). Control and interrupt URBs must fit in it. The USB/IP
        server holds URB data in segments of this size (rounded down to a
        multiple of 1024 bytes) and runs a larger bulk URB, up to
        USBIP_MAX_URB_SIZE, as one transfer per segment.

config USBIP_MAX_URB_SIZE
    int "Maximum bulk URB size"
    range 1024 262144
    default 131072
    help
        Largest URB the USB/IP server accepts; bigger ones fail with
        -EMSGSIZE. The server buffers a whole URB (in segments of
        USBIP_MAX_TRANSFER), so this bounds the memory per in-flight URB.
        Linux usb-storage sends up to 120 KiB (max_sectors 240), so mass
        storage needs at least 122880.

config USBIP_MAX_DEVICES
    int "Maximum exported USB devices"
    range 1 16
    default 8
    help
        Maximum number of simultaneously exported non-hub USB devices.
        Increase this when using downstream hubs with multiple peripherals.

config USBIP_MAX_INFLIGHT_XFERS
    int "Maximum transfers in flight at the USB host"
    range 16 512
    default 128 if IDF_TARGET_ESP32P4 || IDF_TARGET_ESP32S31
    default 64
    help
        Transfers handed to the USB host library at the same time, over all
        devices and endpoints. Transfers queue on their endpoint's pipe, so
        this is not bound by the controller's channel count; it bounds the
        DMA memory in use (one buffer of up to USBIP_MAX_TRANSFER bytes each).
        Bulk and interrupt IN transfers (reads) may hold all but 8 of them,
        so pending reads can never starve OUT data or control requests.

config USBIP_MAX_IN_XFERS_PER_ENDPOINT
    int "Pending IN transfers per endpoint"
    range 1 64
    default 8
    help
        Reads in flight on one bulk or interrupt IN endpoint; further reads
        wait in the backend's queue until one of them completes. Reads are
        not timed out (as on a Linux host): they stay pending until the
        device sends data, the client unlinks them, or the device is gone.
        Linux cdc-acm keeps 16 reads pending per port, usb-serial 2 to 4.

config USBIP_CTRL_XFER_TIMEOUT_MS
    int "Control transfer deadline (ms, 0 = none)"
    range 0 60000
    default 5000
    help
        A control transfer the device has not finished within this time is
        cancelled and answered with -ETIMEDOUT (the host library does not
        enforce a timeout). Linux's own usb_control_msg() timeout usually
        unlinks the URB first. Bulk and interrupt transfers have no deadline.

config USBIP_MAX_INFLIGHT_URBS
    int "Maximum URBs in flight per USB/IP connection"
    range 8 512
    default 64
    help
        URBs accepted from one client connection before the reader waits
        for a reply to go out. Each one holds its data (up to
        USBIP_MAX_URB_SIZE bytes); nothing else is per URB, as no task
        blocks on a transfer. Linux keeps up to 33 URBs pending on an idle
        cdc-acm port (16 reads, 16 writes and the notification read).

config USBIP_NEOPIXEL_GPIO
    int "Neopixel data GPIO"
    default 0
    help
        GPIO connected to a WS2812-compatible neopixel.  Set to -1 to disable.
        When the HTTP UI is loaded the neopixel briefly shows white as a
        visual indicator.

endmenu

menu "Analog I2C Mux Configuration"

    config USBIP_MUX_I2C_SDA_GPIO
        int "Mux control bus SDA GPIO (-1 to disable)"
        default 2 if USBIP_BOARD_ESPRESSIF_ESP32S31_FUNCTION_COREBOARD_1
        default -1
        help
            I2C bus that drives the ADG729/ADG728 analog switches routing the
            shared I2C sensor chain to one DUT (see /api/topology).

    config USBIP_MUX_I2C_SCL_GPIO
        int "Mux control bus SCL GPIO (-1 to disable)"
        default 3 if USBIP_BOARD_ESPRESSIF_ESP32S31_FUNCTION_COREBOARD_1
        default -1

    config USBIP_MUX_I2C_FREQ_HZ
        int "Mux control bus clock (Hz)"
        range 10000 400000
        default 100000

endmenu

menu "Virtual Logic Capture Configuration"

    config USBIP_VIRTUAL_LOGIC_ANALYZER
        bool "Enable virtual logic analyzer"
        default y
        help
            Expose a virtual USB device that streams logic-capture data
            via Perfetto trace format over a CDC-ACM interface.

    config LOGIC_CAPTURE_SAMPLE_RATE_HZ
        int "Sample rate (Hz)"
        default 1000000
        depends on USBIP_VIRTUAL_LOGIC_ANALYZER

    config LOGIC_CAPTURE_GPIO_D0
        int "Channel 0 GPIO"
        default 10
        depends on USBIP_VIRTUAL_LOGIC_ANALYZER

    config LOGIC_CAPTURE_GPIO_D1
        int "Channel 1 GPIO"
        default 11
        depends on USBIP_VIRTUAL_LOGIC_ANALYZER

    config LOGIC_CAPTURE_GPIO_D2
        int "Channel 2 GPIO"
        default 12
        depends on USBIP_VIRTUAL_LOGIC_ANALYZER

    config LOGIC_CAPTURE_GPIO_D3
        int "Channel 3 GPIO"
        default 13
        depends on USBIP_VIRTUAL_LOGIC_ANALYZER

    config LOGIC_CAPTURE_GPIO_D4
        int "Channel 4 GPIO"
        default -1
        depends on USBIP_VIRTUAL_LOGIC_ANALYZER

    config LOGIC_CAPTURE_GPIO_D5
        int "Channel 5 GPIO"
        default -1
        depends on USBIP_VIRTUAL_LOGIC_ANALYZER

    config LOGIC_CAPTURE_GPIO_D6
        int "Channel 6 GPIO"
        default -1
        depends on USBIP_VIRTUAL_LOGIC_ANALYZER

    config LOGIC_CAPTURE_GPIO_D7
        int "Channel 7 GPIO"
        default -1
        depends on USBIP_VIRTUAL_LOGIC_ANALYZER

    config LOGIC_CAPTURE_ENABLE_GPIO
        int "Enable/valid input GPIO (-1 to disable)"
        default -1
        depends on USBIP_VIRTUAL_LOGIC_ANALYZER

    config LOGIC_CAPTURE_ENABLE_ACTIVE_LOW
        bool "Enable pin is active-low"
        default n
        depends on LOGIC_CAPTURE_ENABLE_GPIO != -1

endmenu

menu "Virtual Test Harness Configuration"

    config USBIP_VIRTUAL_HARNESS
        bool "Enable virtual test harness"
        default y
        help
            Expose a virtual USB CDC-ACM device that runs the esp-harness
            SCPI test harness internally.  The device accepts SCPI commands
            from a USB/IP host to drive GPIO, I2C, SPI, and UART buses on
            the bridge MCU.

endmenu
```
